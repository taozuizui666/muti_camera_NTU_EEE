## IMU/iio_device_sync/Kconfig
```kconfig
# SPDX-License-Identifier: BSD-3-Clause
#
# Kconfig entry for Murata SCH16T IMU driver.
# Add this block to drivers/iio/imu/Kconfig (in-tree), or use
# it stand-alone for an out-of-tree build.

config SCH16T
    tristate "Murata SCH16T IMU driver"
    depends on SPI
    select IIO_BUFFER
    select IIO_TRIGGERED_BUFFER
    help
      Say Y or M here to enable support for the Murata SCH16T series
      6-DOF inertial measurement units (gyroscope + accelerometer)
      connected over SPI.

      Supported variants:
        - SCH16T-K01  (high-sensitivity gyro, 1600–6400 LSB/dps)
        - SCH16T-K10  (standard-range gyro,   100–400  LSB/dps)

      The driver registers with the IIO subsystem and exposes angular
      velocity (rad/s), linear acceleration (m/s²) and temperature
      channels through sysfs and the IIO triggered-buffer interface.

      To compile this driver as a module, choose M here. The module
      will be called sch16t.
```

## WiFi_module/BL616_HostDriver/Kconfig
```kconfig
config BL616L
        tristate "BL616L wireless driver"
        select CFG80211
        select WIRELESS_EXT
        select WEXT_CORE
        select WEXT_PROC
        select WIRELESS_EXT
        select CRYPTO
        select WEXT_SPY
        select WEXT_PRIV
        default m
        help
          This is for BL616L SDIO/USB wireless driver
 
if BL616L

choice
    prompt "BL616L WIFI BLE configuration"
    default BL_SDIO
    help
      Select WIFI only or WIFI BLE combo, and their hardware interface. Select only one of these [BL_SDIO BL_BTSDU BL_BTUART BL_USB BL_BTUSB]

config BL_SDIO
    bool "WIFI over SDIO only."

config BL_BTSDU
    bool "WIFI over SDIO and BLE over SDIO combo."

config BL_BTUART
    bool "WIFI over SDIO and BLE over UART combo."

config BL_USB
    bool "WIFI over USB only."

config BL_BTUSB
    bool "WIFI over USB and BLE over USB combo."

endchoice

endif # BL616L
```
