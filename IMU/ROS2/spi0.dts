/dts-v1/;
/plugin/;

#include <dt-bindings/gpio/gpio.h>
#include <dt-bindings/pinctrl/rockchip.h>

/ {
	fragment@0 {
		target = <&spi0>;

		__overlay__ {
			status = "okay";
			#address-cells = <1>;
			#size-cells = <0>;
			pinctrl-names = "default";
			pinctrl-0 = <&spi0m3_cs0 &spi0m3_cs1 &spi0m3_pins>;
			num-cs = <1>;

			sch16t_imu: imu@0 {
                // compatible = "spidev";
                compatible = "murata,sch16t-k10";
				reg = <0>; 
				spi-max-frequency = <10000000>; 
			};
		};
	};
};
